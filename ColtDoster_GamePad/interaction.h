



int interaction[numLevels][tileW * tileH]{
  // Level 0 - Bedroom
  {
    0x01, 0x01, 0xFF, 0xFF, 0xFF, 0xFF, 0xFF, 0xFF, 0xFF, 0xFF, 0xFF, 0xFF, 0xFF, 0xFF, 0xFF, 0xFF, 
    0x01, 0x01, 0x00, 0x00, 0x00, 0x00, 0x00, 0x00, 0x00, 0x00, 0x00, 0x00, 0x00, 0x00, 0x00, 0xFF, 
    0xFF, 0x00, 0x00, 0x00, 0x00, 0x00, 0x00, 0x00, 0x00, 0x00, 0x00, 0x00, 0x00, 0x00, 0x00, 0xFF, 
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    0xFF, 0xFF, 0xFF, 0xFF, 0xFF, 0xFF, 0xFF, 0xFF, 0xFF, 0xFF, 0xFF, 0xFF, 0xFF, 0xFF, 0xFF, 0xFF, 
    
 // 0x01 = the door pad to go to the second level
  
  },
  // Level 1 - House Of Dreams
  {
    0xFF, 0xFF, 0xFF, 0xFF, 0xFF, 0xFF, 0xFF, 0xFF, 0xFF, 0xFF, 0xFF, 0xFF, 0xFF, 0xFF, 0xFF, 0xFF, 
    0xFF, 0x00, 0x00, 0x00, 0x00, 0x00, 0x00, 0x00, 0x00, 0x00, 0x00, 0x00, 0x00, 0x00, 0x00, 0xFF, 
    0xFF, 0x00, 0x00, 0x00, 0x00, 0x00, 0x00, 0x00, 0x00, 0x00, 0x00, 0xFF, 0xFF, 0x00, 0x00, 0xFF, 
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    0xFF, 0xFF, 0xFF, 0xFF, 0xFF, 0xFF, 0x02, 0x02, 0x02, 0x02, 0xFF, 0xFF, 0xFF, 0xFF, 0xFF, 0xFF, 
    
 // 0x02 = the door pad to go to the third level
  
  },
    // Level 2 - stretch road
  {
    0xFF, 0xFF, 0xFF, 0xFF, 0xFF, 0xFF, 0x03, 0x03, 0x03, 0x03, 0xFF, 0xFF, 0xFF, 0xFF, 0xFF, 0xFF, 
    0xFF, 0x00, 0x00, 0x00, 0x00, 0x00, 0x00, 0x00, 0x00, 0x00, 0x00, 0x00, 0x00, 0x00, 0x00, 0xFF, 
    0xFF, 0x00, 0x00, 0x00, 0x00, 0x00, 0x00, 0x00, 0x00, 0x00, 0x00, 0x00, 0x00, 0x00, 0x00, 0xFF, 
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    0xFF, 0xFF, 0xFF, 0xFF, 0xFF, 0xFF, 0x04, 0x04, 0x04, 0x04, 0xFF, 0xFF, 0xFF, 0xFF, 0xFF, 0xFF, 
    
 // 0x03 = the door pad to go back to the previous level
 // 0x04 = the door pad to the next level
  
  },
      // Level 3 - ford room
  {
    0xFF, 0xFF, 0xFF, 0xFF, 0xFF, 0xFF, 0xFF, 0xFF, 0xFF, 0xFF, 0xFF, 0xFF, 0xFF, 0xFF, 0xFF, 0xFF, 
    0xFF, 0x00, 0x00, 0x00, 0x00, 0x00, 0x00, 0x00, 0x00, 0x00, 0x00, 0x00, 0x00, 0x00, 0x00, 0xFF, 
    0xFF, 0x00, 0x00, 0x00, 0x00, 0x00, 0x00, 0x00, 0x00, 0x00, 0x00, 0x00, 0x00, 0x00, 0x00, 0xFF, 
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    0xFF, 0xFF, 0xFF, 0xFF, 0xFF, 0xFF, 0xFF, 0xFF, 0xFF, 0xFF, 0xFF, 0xFF, 0xFF, 0xFF, 0xFF, 0xFF, 
    
 // 0x05 = the door pad to to the next level
 // 0x06 = the safe door
  
  },
    // Level 4 - HackBerry
  {
    0xFF, 0xFF, 0xFF, 0xFF, 0xFF, 0xFF, 0xFF, 0xFF, 0xFF, 0xFF, 0xFF, 0xFF, 0xFF, 0xFF, 0xFF, 0xFF, 
    0xFF, 0x00, 0x00, 0x00, 0x00, 0x00, 0x00, 0x00, 0x00, 0x00, 0x00, 0x00, 0x00, 0x08, 0x08, 0xFF, 
    0xFF, 0x00, 0x00, 0xFF, 0xFF, 0x00, 0x00, 0xFF, 0xFF, 0x00, 0x00, 0x00, 0x00, 0x00, 0x00, 0xFF, 
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    0xFF, 0xFF, 0xFF, 0xFF, 0xFF, 0xFF, 0xFF, 0xFF, 0xFF, 0xFF, 0xFF, 0xFF, 0xFF, 0xFF, 0xFF, 0xFF, 
    
 // 0x07 = the door pad to go to the next level
 // 0x08 = the interactive pad where you'll get tools

  },

    // Level 5 - Hoge building
  {
    0xFF, 0xFF, 0xFF, 0xFF, 0xFF, 0xFF, 0xFF, 0xFF, 0xFF, 0xFF, 0xFF, 0xFF, 0xFF, 0xFF, 0xFF, 0xFF, 
    0xFF, 0x00, 0x00, 0x00, 0x00, 0x00, 0x00, 0x00, 0x00, 0x00, 0x00, 0x00, 0x00, 0x00, 0x00, 0xFF, 
    0xFF, 0x00, 0x00, 0x00, 0x00, 0x00, 0x00, 0x00, 0x00, 0x00, 0x00, 0xFF, 0xFF, 0x00, 0x00, 0xFF, 
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    0xFF, 0xFF, 0xFF, 0xFF, 0xFF, 0xFF, 0x09, 0x09, 0x09, 0x09, 0xFF, 0xFF, 0xFF, 0xFF, 0xFF, 0xFF, 
    
 // 0x09 = the door pad to go to back to the previous level
  
  } 
};

  // Generate an Array of Neighbors for Checking
int neighbors[192][8];

boolean canMove; // allows the proposed space the player wants to move to be valid.
int curTile; 
int curTileX;
int curTileY;


void initNeighbors(){
  for (int i = 0; i < tileW * tileH; i++){
    // General Rule
    int N = i - tileW; int NE = (i - tileW) + 1;  int E = i + 1;  int SE = (i + tileW) + 1;  
    int S = i + tileW; int SW = (i + tileW) - 1;  int W = i - 1;  int NW = (i - tileW) - 1;
    
    // Exceptions
    if(i < tileW){NW = -1; N = -1; NE = -1;}
    if(i > (tileW * tileH) - (tileW + 1)){SW = -1; S = -1; SE = -1;}
    if (i % tileW == 0){NW = -1; W = -1; SW = -1;}
    if ((i + 1) % tileW == 0){NE = -1; E = -1; SE = -1;}

    neighbors[i][0] = N;  neighbors[i][1] = NE;  neighbors[i][2] = E;  neighbors[i][3] = SE;  
    neighbors[i][4] = S;  neighbors[i][5] = SW;  neighbors[i][6] = W;  neighbors[i][7] = NW;  
  }
}

boolean checkMove(int level, int curX, int curY, int curW, int curH){

  curTileX = curX/tileSize;
  curTileY = curY/tileSize;

   curTile = curTileX + (curTileY * tileW); 

  canMove = true;

  for(int i = 0; i < 8; i++){
    int whichTile = neighbors[curTile][i];                          // Get Current Neighbor    
    int neighborX = (whichTile % tileW) * tileSize;      // Get X Value of Neighbor
     int neighborY = (whichTile / tileW) * tileSize;      // Get Y Value of Neighbor

    boolean isOut = false; if(interaction[level][whichTile] == 0xFF){isOut = true;}
    boolean xMin = false; if(curX < neighborX + tileSize){xMin = true;}
    boolean xMax = false; if(curX + curW > neighborX){xMax = true;}
    boolean yMin = false; if(curY < neighborY + tileSize){yMin = true;}
    boolean yMax = false; if(curY + curH > neighborY){yMax = true;}

    if(isOut == true && xMin == true && xMax == true && yMin == true && yMax == true){
      canMove = false;
    }
//
//  Serial.print("LVL: "); Serial.print(level); 
//    Serial.print("\t X: "); Serial.print(curX); Serial.print("\t Y: "); Serial.print(curY); 
//    Serial.print("\t W: ");  Serial.print(curW); Serial.print("\t H: "); Serial.print(curH); 
//    Serial.print("\t CT: "); Serial.print(curTile); Serial.print("\t NT: "); Serial.print(whichTile); 
//    Serial.print("\t NX: "); Serial.print(neighborX); Serial.print("\t NY: "); Serial.print(neighborY); 
//    Serial.print("\t OUT "); Serial.print(isOut);
//    Serial.print("\t xMin: "); Serial.print(xMin); Serial.print("\t xMax: "); Serial.print(xMax); 
//    Serial.print("\t yMin: "); Serial.print(yMin); Serial.print("\t yMax: "); Serial.print(yMax); 
//    Serial.print("\t ? "); Serial.print(canMove);
//    Serial.println();
//  
  
  }
  

  return canMove;


}


  
  
